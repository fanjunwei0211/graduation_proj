#include "laser.h"

static unsigned char TxBuffer[256];
unsigned char	LaserRxBuffer[8];
static unsigned char count=0; 
volatile char laser_RtuFlag = 0;
uint16_t laserDis[3]={0,0,0};  
static const uint8_t aucCRCHi[] =
{
		0x00, 0xC1, 0x81, 0x40, 0x01, 0xC0, 0x80, 0x41, 0x01, 0xC0, 0x80, 0x41,
		0x00, 0xC1, 0x81, 0x40, 0x01, 0xC0, 0x80, 0x41, 0x00, 0xC1, 0x81, 0x40,
		0x00, 0xC1, 0x81, 0x40, 0x01, 0xC0, 0x80, 0x41, 0x01, 0xC0, 0x80, 0x41,
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		0x00, 0xC1, 0x81, 0x40
};

static const uint8_t aucCRCLo[] =
{
		0x00, 0xC0, 0xC1, 0x01, 0xC3, 0x03, 0x02, 0xC2, 0xC6, 0x06, 0x07, 0xC7,
		0x05, 0xC5, 0xC4, 0x04, 0xCC, 0x0C, 0x0D, 0xCD, 0x0F, 0xCF, 0xCE, 0x0E,
		0x0A, 0xCA, 0xCB, 0x0B, 0xC9, 0x09, 0x08, 0xC8, 0xD8, 0x18, 0x19, 0xD9,
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		0x41, 0x81, 0x80, 0x40
};

static uint16_t usMBCRC16( uint8_t * pucFrame, uint16_t usLen )
{
    
    uint8_t           ucCRCHi = 0xFF;
    uint8_t           ucCRCLo = 0xFF;
    int             iIndex;

    while( usLen-- )
    {
        iIndex = ucCRCLo ^ *( pucFrame++ );
        ucCRCLo = ( uint8_t )( ucCRCHi ^ aucCRCHi[iIndex] );
        ucCRCHi = aucCRCLo[iIndex];
    }
    return ( uint16_t )( ucCRCHi << 8 | ucCRCLo );
}

static int CheckCrcOK(const uint8_t* buf, uint32_t len)
{
    uint16_t chechcrc,checksum;
    chechcrc = (buf[len - 1] << 8) | buf[len - 2];
    checksum = usMBCRC16((uint8_t *)buf, len - 2);
    if(chechcrc != checksum)
    {
        return 0;
    }
    return 1;
}

//#ifdef USE_RTOS

//static void mutex_lock(void)
//{

//}

//static void mutex_unlock(void)
//{

//}

//#endif

//static void timerStop(void)
//{
//    HAL_TIM_Base_Stop_IT(&htim14);
//}

//static void timerStart(void)
//{
//    __HAL_TIM_SET_COUNTER(&htim14, 0);
//    HAL_TIM_Base_Start_IT(&htim14);
//}

//static void delayms(uint32_t nms)
//{
//    HAL_Delay(nms);
//}

//static uint32_t sendData(const void* buf, uint32_t len)
//{
//    if(HAL_UART_Transmit(&huart2, (uint8_t *)buf, len, 100) != HAL_OK)
//    {
//        len = 0;
//    }
//    return len;
//}

//MBRTUMaterTypeDef MBRTUHandle =
//{
//    .delayms                      = delayms,
//    .timerStart                   = timerStart,
//    .timerStop                    = timerStop,
//    .sendData                     = sendData,

//#ifdef USE_RTOS  // 使用了RTOS那么需要实现互斥
//    .lock                         = mutex_lock,
//    .unlock                       = mutex_unlock,
//#endif
//};

//static uint32_t MBRTUMasterRead(MBRTUMaterTypeDef* pMaster, uint8_t ucSlaveAddr, uint8_t ucCmd, uint16_t usStartAddr, uint16_t usNum)
//{
//    uint16_t crc;

//    pMaster->ucBuf[0] = ucSlaveAddr;
//    pMaster->ucBuf[1] = ucCmd;
//    pMaster->ucBuf[2] = ((usStartAddr & 0XFF00) >> 8);
//    pMaster->ucBuf[3] = (usStartAddr & 0XFF);
//    pMaster->ucBuf[4] = ((usNum & 0XFF00) >> 8);
//    pMaster->ucBuf[5] = (usNum & 0XFF);

//    crc = usMBCRC16( ( uint8_t * )pMaster->ucBuf, 6);
//    pMaster->ucBuf[6] = ( uint8_t )( crc & 0xFF );
//    pMaster->ucBuf[7] = ( uint8_t )( crc >> 8 );

//    return pMaster->sendData(pMaster->ucBuf, 8);
//}

void UART2_PutChar(unsigned char DataToSend)
{
	TxBuffer[count++] = DataToSend;  
  while(__HAL_UART_GET_FLAG(&huart2,UART_FLAG_TC)!=SET);		//等待发送结束
}

//040300030001745F   4号连续发送
//050300030001758E   5号连续发送
//06030003000175BD	 6号连续测距
//060300020001247D   打开激光
//060300020000E5BD   关闭激光
//050300020001244E打开激光
//050300020000E58E关闭激光
//LaseeSerialData为串口中断调用函数，串口每收到一个数据，调用一次这个函数。
void laserOpenClose(uint8_t address, int mode){
	uint16_t crc;
	uint8_t ucBuf[8];

	ucBuf[0] = address;
	ucBuf[1] = 0x03;
	ucBuf[2] = 0x00;
	ucBuf[3] = 0x02;
	ucBuf[4] = 0x00;
	ucBuf[5] = mode;

	crc = usMBCRC16( ( uint8_t * )ucBuf, 6);
	ucBuf[6] = ( uint8_t )( crc & 0xFF );
	ucBuf[7] = ( uint8_t )( crc >> 8 );
	HAL_UART_Transmit(&huart2, (uint8_t *)ucBuf, 8, 100);
}


/**
 * 主机读取激光测距仪数据
 * @param  ucSlaveAddress 从机地址
 * @param  usAddress      要读取的保持寄存器起始地址
 * @param  usNum          要读取的保持寄存器数量
 * @param  usTimeout      超时时间,单位毫秒
 * @param  pusRegBuffer   存储读取到的寄存器值
 */
void LaserDistanceGet(uint8_t ucSlaveAddress, uint16_t usAddress, uint16_t usNum)
{
	
//	MBRTUMasterRead(psModbus, ucSlaveAddress, 0X03, usAddress, usNum);
	uint16_t crc;
	uint8_t ucBuf[8];
	ucBuf[0] = ucSlaveAddress;
	ucBuf[1] = 0x03;
	ucBuf[2] = ((usAddress & 0XFF00) >> 8);;
	ucBuf[3] = (usAddress & 0XFF);
	ucBuf[4] = ((usNum & 0XFF00) >> 8);
	ucBuf[5] = usNum&0xFF;
	crc = usMBCRC16( ( uint8_t * )ucBuf, 6);
	ucBuf[6] = ( uint8_t )( crc & 0xFF );
	ucBuf[7] = ( uint8_t )( crc >> 8 );
	HAL_UART_Transmit(&huart2, (uint8_t *)ucBuf, 8, 100);
}

//连续测距开关
void LaserDistanceGetSerial(uint8_t ucSlaveAddress, uint16_t usAddress, uint16_t usNum)
{
	
//	MBRTUMasterRead(psModbus, ucSlaveAddress, 0X03, usAddress, usNum);
	uint16_t crc;
	uint8_t ucBuf[8];
	ucBuf[0] = ucSlaveAddress;
	ucBuf[1] = 0x03;
	ucBuf[2] = ((usAddress & 0XFF00) >> 8);;
	ucBuf[3] = (usAddress & 0XFF);
	ucBuf[4] = ((usNum & 0XFF00) >> 8);
	ucBuf[5] = usNum&0xFF;
	crc = usMBCRC16( ( uint8_t * )ucBuf, 6);
	ucBuf[6] = ( uint8_t )( crc & 0xFF );
	ucBuf[7] = ( uint8_t )( crc >> 8 );
	HAL_UART_Transmit(&huart2, (uint8_t *)ucBuf, 8, 100);
}

void LaserSerial2Data(unsigned char ucData)
{
	static unsigned char ucRxBuffer[20];
	static unsigned char ucRxCnt = 0;	
	
	ucRxBuffer[ucRxCnt++]=ucData;	//将收到的数据存入缓冲区中
	if ((ucRxBuffer[0]!=0x04) && (ucRxBuffer[0]!=0x05) && (ucRxBuffer[0]!=0x06)) //数据头不对，则重新开始寻找数据头
	{
		ucRxCnt=0;
		return;
	}
	if (ucRxCnt<8) {return;}//数据不满8个，则返回
	else
	{
		switch(ucRxBuffer[0])//判断数据是哪个激光测距仪返回的
		{
			case 0x04:	laserDis[0] = (ucRxBuffer[4]<<8) | ucRxBuffer[5];break;
			case 0x05:	laserDis[1] = (ucRxBuffer[4]<<8) | ucRxBuffer[5];break;
			case 0x06:	laserDis[2] = (ucRxBuffer[4]<<8) | ucRxBuffer[5];break;
		}
//		MBRTUHandle.usStatus++;
//		MBRTUHandle.timerStart();
		ucRxCnt=0;//清空缓存区
	}
}

void LaserSerial2DataL(unsigned char* ucRxBuffer)
{
	if ((ucRxBuffer[0]==0x04) || (ucRxBuffer[0]==0x05) || (ucRxBuffer[0]==0x06)) //数据头不对，则重新开始寻找数据头
	{
		switch(ucRxBuffer[0])//判断数据是哪个激光测距仪返回的
		{
			case 0x04:	laserDis[0] = (ucRxBuffer[4]<<8) | ucRxBuffer[5];break;
			case 0x05:	laserDis[1] = (ucRxBuffer[4]<<8) | ucRxBuffer[5];break;
			case 0x06:	laserDis[2] = (ucRxBuffer[4]<<8) | ucRxBuffer[5];break;
		}
	}
}
